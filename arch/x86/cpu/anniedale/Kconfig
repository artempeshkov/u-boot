## arch/x86/cpu/anniedale/Kconfig
```kconfig
# SPDX-License-Identifier: GPL-2.0+
#
# Copyright (c) 2017 Intel Corporation

config INTEL_ANNIEDALE
	bool
	depends on INTEL_MID
	select INTEL_MID_SERIAL
	select MMC
	select MMC_SDHCI
	select MMC_SDHCI_SDMA
	select MMC_SDHCI_TANGIER
	select MISC
	select USB
	select USB_XHCI_HCD
	select USB_DWC3
	select USB_DWC3_GENERIC

if INTEL_ANNIEDALE

config SYS_CAR_ADDR
	hex
	default 0x19200000

config SYS_CAR_SIZE
	hex
	default 0x4000
	help
	  Space in bytes in eSRAM used as Cache-As-RAM (CAR).
	  Note this size must not exceed eSRAM's total size.

endif
```

## board/asus/Kconfig
```kconfig
# SPDX-License-Identifier: GPL-2.0+
#
# Copyright (C) 2015, Bin Meng <bmeng.cn@gmail.com>

if VENDOR_ASUS

choice
	prompt "Mainboard model"
	optional

config TARGET_Z00XS
	bool "Zenfone Zoom"
	help
	  Zenfone Zoom

endchoice

source "board/asus/z00xs/Kconfig"

endif
```

## board/asus/z00xs/Kconfig
```kconfig
if TARGET_Z00XS

config SYS_BOARD
	default "z00xs"

config SYS_VENDOR
	default "asus"

config SYS_SOC
	default "anniedale"

config SYS_MALLOC_LEN
	default 0x08000000

config TEXT_BASE
	default 0x10F00000

#config ROM_TABLE_ADDR
#	default 0x0e4500

#config ROM_TABLE_SIZE
#	default 0x007b00

config BOARD_SPECIFIC_OPTIONS # dummy
	def_bool y
	select X86_LOAD_FROM_32_BIT
	select INTEL_MID
	select INTEL_ANNIEDALE
	select BOARD_LATE_INIT
	select MD5

endif
```

## configs/z00xs_defconfig
```kconfig
CONFIG_X86=y
CONFIG_SYS_MALLOC_LEN=0x8000000
CONFIG_ENV_SIZE=0x10000
CONFIG_DEFAULT_DEVICE_TREE="z00xs"
CONFIG_DEBUG_UART_BASE=0x7f700000
CONFIG_DEBUG_UART_CLOCK=0
CONFIG_VENDOR_ASUS=y
CONFIG_TARGET_Z00XS=y
CONFIG_DEBUG_UART=y
CONFIG_SMP=y
CONFIG_SYS_CBSIZE=2048
CONFIG_SYS_PBSIZE=2068
CONFIG_LOGLEVEL=7
# CONFIG_SYS_DEVICE_NULLDEV is not set
CONFIG_LOG=y
# CONFIG_LOG_CONSOLE is not set
CONFIG_BOARD_EARLY_INIT_R=y
CONFIG_HUSH_PARSER=y
CONFIG_SYS_MAXARGS=128
CONFIG_CMD_CPU=y
CONFIG_CMD_ASKENV=y
CONFIG_CMD_GREPENV=y
CONFIG_CMD_ENV_CALLBACK=y
CONFIG_CMD_ENV_FLAGS=y
# CONFIG_CMD_BIND is not set
CONFIG_CMD_DFU=y
CONFIG_CMD_GPT=y
CONFIG_CMD_PART=y
# CONFIG_CMD_SCSI is not set
CONFIG_CMD_TIMER=y
CONFIG_CMD_HASH=y
CONFIG_CMD_EXT4=y
CONFIG_CMD_EXT4_WRITE=y
CONFIG_CMD_FAT=y
CONFIG_CMD_FS_GENERIC=y
CONFIG_OF_EMBED=y
CONFIG_USE_DEFAULT_ENV_FILE=y
CONFIG_DEFAULT_ENV_FILE="board/asus/z00xs/z00xs.env"
CONFIG_CPU=y
CONFIG_DFU_TIMEOUT=y
CONFIG_DFU_RAM=y
CONFIG_FRAMEBUFFER_SERIAL=y
CONFIG_DEBUG_UART_FRAMEBUFFER=y
CONFIG_DM_USB_GADGET=y
CONFIG_USB_GADGET=y
CONFIG_USB_GADGET_VENDOR_NUM=0x8087
CONFIG_USB_GADGET_PRODUCT_NUM=0x0a99
CONFIG_USB_GADGET_DOWNLOAD=y
CONFIG_USB_FUNCTION_ACM=y
CONFIG_VIDEO_SIMPLE=y
CONFIG_WDT=y
CONFIG_GENERATE_ACPI_TABLE=y
```
